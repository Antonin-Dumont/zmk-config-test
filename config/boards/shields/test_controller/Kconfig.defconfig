## config/boards/shields/test_controller/Kconfig.defconfig
```kconfig
if SHIELD_TEST_CONTROLLER

config ZMK_KEYBOARD_NAME
    default "test_controller"

endif
```

## config/boards/shields/test_controller/Kconfig.shield
```kconfig
config SHIELD_TEST_CONTROLLER
    def_bool $(shields_list_contains, test_controller)
```
